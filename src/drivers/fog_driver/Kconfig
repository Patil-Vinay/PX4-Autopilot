## src/drivers/fog_driver/Kconfig
```kconfig
menuconfig DRIVERS_FOG_DRIVER
	bool "FOG Driver"
	default n
	---help---
		Enable support for VehicleAngularVelocity CAN driver
```

## src/drivers/helloworld_can/Kconfig
```kconfig
menuconfig DRIVERS_HELLOWORLD_CAN
	bool "helloworld_can"
	default n
	---help---
		Enable support for HelloWorld CAN driver
```

## src/drivers/vehicle_angular_velocity_can/Kconfig
```kconfig
menuconfig DRIVERS_VEHICLE_ANGULAR_VELOCITY_CAN
	bool "vehicle_angular_velocity_can"
	default n
	---help---
		Enable support for VehicleAngularVelocity CAN driver
```

## src/drivers/work_item_fog/Kconfig
```kconfig
menuconfig DRIVERS_WORK_ITEM_FOG
	bool "work_item_fog"
	default n
	---help---
		Enable support for work_item_fog
```

## src/examples/angular_velocity_telem/Kconfig
```kconfig
menuconfig EXAMPLES_ANGULAR_VELOCITY_TELEM
	bool "Angular Velocity Telemetry"
	default n
	---help---
		This module publishes vehicle angular velocity data to the TELEM2 port.
```

## src/examples/can_frame/Kconfig
```kconfig
menuconfig EXAMPLES_CAN_FRAME
    bool "can_frame"
    default n
    ---help---
        Enable support for can_sender
```

## src/examples/can_reader/Kconfig
```kconfig
menuconfig EXAMPLES_CAN_READER
    bool "can_reader"
    default n
    ---help---
        Enable support for can_reader
```

## src/examples/can_sender/Kconfig
```kconfig
menuconfig EXAMPLES_CAN_SENDER
    bool "can_sender"
    default n
    ---help---
        Enable support for can_sender
```

## src/examples/combined_reader/Kconfig
```kconfig
menuconfig EXAMPLES_COMBINED_READER
    bool "combined_reader"
    default n
    ---help---
        Enable support for combined_reader
```

## src/examples/gimbal_attitude_status/Kconfig
```kconfig
menuconfig EXAMPLES_GIMBAL_ATTITUDE_STATUS
    bool "Gimbal Attitude Status"
    default n
    ---help---
        This module publishes gimbal device attitude status to UORB.
```

## src/examples/gimbal_attitude_status_publisher/Kconfig
```kconfig
menuconfig EXAMPLES_GIMBAL_ATTITUDE_STATUS_PUBLISHER
    bool "Gimbal Attitude Status Publisher"
    default n
    ---help---
        This module publishes gimbal device attitude status to UORB.
```

## src/examples/gyro_printer/Kconfig
```kconfig
menuconfig EXAMPLES_GYRO_PRINTER
    bool "gyro_printer"
    default n
    ---help---
        Enable support for gyro_printer
```

## src/examples/send_integers/Kconfig
```kconfig
menuconfig EXAMPLES_SEND_INTEGERS
	bool "Send Integers Example"
	default n
	---help---
		Enable the send_integers example application.
```

## src/examples/send_telem_angle/Kconfig
```kconfig
menuconfig EXAMPLES_SEND_TELEM_ANGLE
	bool "Send Telem Angle"
	default n
	---help---
		Enable the send_telem_velo example application.
```

## src/examples/send_telem_velo/Kconfig
```kconfig
menuconfig EXAMPLES_SEND_TELEM_VELO
	bool "Send Telem Velo Example"
	default n
	---help---
		Enable the send_telem_velo example application.
```

## src/examples/stabilisation/Kconfig
```kconfig
menuconfig EXAMPLES_STABILISATION
    bool "stabilisation"
    default n
    ---help---
        Enable support for stabilisation
```
